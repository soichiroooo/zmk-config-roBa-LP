## config/west.yml
```yaml
manifest:
  remotes:
    - name: zmkfirmware
      url-base: https://github.com/zmkfirmware
    - name: kumamuk-git
      url-base: https://github.com/kumamuk-git
    - name: caksoylar
      url-base: https://github.com/caksoylar
    - name: zzeneg
      url-base: https://github.com/zzeneg

  projects:
    - name: zmk
      remote: zmkfirmware
      revision: v0.3-branch
      import: app/west.yml

    - name: zmk-pmw3610-driver
      remote: kumamuk-git
      revision: main

    - name: zmk-rgbled-widget
      remote: caksoylar
      revision: v0.3-branch

    - name: zmk-raw-hid
      remote: zzeneg
      revision: 6a37765dfab6197292e7a9f47305dcf87386d56a

  self:
    path: config
```

## modules/layer_report/Kconfig
```kconfig
config ROBA_LAYER_REPORT
    bool "Report the active layer to the host over raw HID"
    depends on RAW_HID
```
